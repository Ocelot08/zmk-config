## config/west.yml
```yaml
manifest:
  remotes:
    - name: zmkfirmware
      url-base: https://github.com/zmkfirmware
    - name: Ocelot08
      url-base: https://github.com/Ocelot08
  projects:
    - name: zmk
      remote: Ocelot08
      revision: base
      import: app/west.yml
  self:
    path: config
```
